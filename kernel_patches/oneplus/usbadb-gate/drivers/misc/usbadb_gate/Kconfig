## kernel_patches/oneplus/usbadb-gate/drivers/misc/usbadb_gate/Kconfig
```kconfig
# SPDX-License-Identifier: GPL-2.0-only
config USBADB_GATE
	bool "publish whether a non-dumb USB host is attached"
	depends on USB
	depends on USB_GADGET
	help
	  Publishes whether the USB gadget is configured by a real host, so that
	  Android's adb daemon can be kept running only while a PC is attached.

	  Detection is the gadget state reported by the UDC core: only
	  "configured" means a host sent SET_CONFIGURATION, which a dumb charger
	  never does.

	  THIS DRIVER RUNS NOTHING. It only publishes. The acting half is
	  patches/usbadb_gate.rc, which init starts; a child spawned from kernel
	  context cannot make init act on a setprop or a service control message
	  (measured, with SELinux permissive: every tool exits 0 and nothing
	  changes), so the kernel decides and a legitimate caller carries it out.

	  Event driven throughout: the gadget state notifier is edge triggered and
	  the hand-off node blocks its reader, so there is no polling, no timer and
	  no wakeup at all while the cable state is steady.

	  Hand-off: /dev/usbadb_gate (0600) returns one line per verdict change,
	      blocking until then: "on configured 7"
	  Control:  /sys/kernel/usbadb_gate/state
	      0 = adb forced off
	      pc = auto, follow the cable (default)
	      1 = adb forced on
	  Read:     /sys/kernel/usbadb_gate/link
	      "adb=1 udc=configured src=event events=12 mode=pc"

	  Only meaningful on Android devices with a USB gadget driver.

	  If unsure, say N.

config USBADB_GATE_UDC_STATE
	string "Gadget state node"
	depends on USBADB_GATE
	default "/sys/class/udc/a600000.dwc3/state"
	help
	  sysfs node whose content says whether a host configured us.
	  "configured" means a PC; anything else ("not attached", "attached",
	  "powered", "suspend") means no usable data link, so adb stays off.

	  Find yours with:
	    for d in /sys/class/udc/*; do echo -n "$d: "; cat "$d/state"; done

	  Qualcomm SoCs are usually a600000.dwc3, MediaTek 11200000.usb.
```
